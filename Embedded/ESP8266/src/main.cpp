#include <Arduino.h>
#include <U8g2lib.h>
#include <SPI.h>

// ESP8266 Donanımsal SPI Pinleri (D8=CS, D7=MOSI, D5=CLK)
#define LCD_CS 15
#define LCD_RST U8X8_PIN_NONE // Donanımsal reset yok, ekranın RST'sini 3.3V'a bağlayın

// U8G2 Nesnesi (ST7920 için donanımsal SPI kullanımı)
U8G2_ST7920_128X64_F_HW_SPI u8g2(U8G2_R2, /* CS=*/ LCD_CS, /* reset=*/ LCD_RST);

// İpek Yolu GKB Logosu (65x64 XBM formatı - Ortalı Gösterim İçin)
// NOT: Çevrimiçi araçtan aldığınız 65x64 boyutundaki byte dizisinin içerisindeki (0x00...) hex verilerini 
// birebir bu dizinin içine yapıştırınız. Derleme stabilitesi ve RAM optimizasyonu (Heap Fragmentation önlemi) 
// için PROGMEM (Flash Bellek) kullanılmıştır. 65 piksel genişlik satır başına 9 byte eder (9*64 = 576 byte).
const unsigned char image_ipekyolu_gkb_logo_beyaz_bits[] U8X8_PROGMEM = {
  0x00,0x00,0x00,0x00,0x00,0x00,0x00,0x00,0x00,0x00,0x00,0x00,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0x00
};

void setup() {
  // ESP32-S3 ile haberleşme portu (Baud rate aynı olmalı)
  Serial.begin(115200);
  
  u8g2.begin();
  u8g2.enableUTF8Print(); 
  
  // İlk açılış ekranı
  u8g2.clearBuffer();
  u8g2.setFont(u8g2_font_helvB12_tf);
  u8g2.drawStr(10, 35, "Baglanti...");
  u8g2.sendBuffer();
}

void parseCommand(String payload) {
  // Beklenen Format: KOMUT|BASLIK|MESAJ
  int firstPipe = payload.indexOf('|');
  int secondPipe = payload.lastIndexOf('|');
  
  if (firstPipe == -1 || secondPipe == -1) return; // Hatalı format
  
  String cmd = payload.substring(0, firstPipe);
  String title = payload.substring(firstPipe + 1, secondPipe);
  String msg = payload.substring(secondPipe + 1);
  
  if (cmd == "SHOW") {
    u8g2.setPowerSave(0); // Ekran uyuyorsa uyandır
    u8g2.clearBuffer();
    
    // Üst Çizgi ve Sabit Başlık
    u8g2.setFont(u8g2_font_helvB08_tf);
    u8g2.drawStr(0, 10, "Ipek Yolu GKB");
    u8g2.drawLine(0, 12, 128, 12);
    
    // Dinamik Başlık (İsim veya Durum)
    u8g2.setFont(u8g2_font_helvB10_tf); 
    u8g2.setCursor(0, 35);
    u8g2.print(title);
    
    // Alt Mesaj
    u8g2.setFont(u8g2_font_helvB08_tf);
    u8g2.setCursor(0, 58);
    u8g2.print(msg);
    
    u8g2.sendBuffer();
  } 
  else if (cmd == "LOGO") {
    u8g2.setPowerSave(0); // Ekranı uyanık tut
    u8g2.clearBuffer();
    
    // Şeffaflık ve Bitmap modları aktif edilerek kalite artırılıyor
    u8g2.setBitmapMode(1);
    u8g2.setFontMode(1);
    
    // 128x64 ekranda 65x64 logoyu tam ortaya (X ekseninde 31 piksel boşluk ile) çiziyoruz
    u8g2.drawXBMP(31, 0, 65, 64, image_ipekyolu_gkb_logo_beyaz_bits);
    
    u8g2.sendBuffer();
  }
  else if (cmd == "SLEEP") {
    u8g2.setPowerSave(1);
  } 
  else if (cmd == "WAKE") {
    u8g2.setPowerSave(0);
  }
}

void loop() {
  // ESP32-S3'ten gelen verileri dinle
  if (Serial.available()) {
    String data = Serial.readStringUntil('\n');
    data.trim();
    if (data.length() > 0) {
      parseCommand(data);
    }
  }
}